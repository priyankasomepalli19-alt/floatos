## Config.in
```kconfig
# FloatOS external Buildroot tree.
source "$BR2_EXTERNAL_FLOATOS_PATH/package/floatos-shell/Config.in"
```

## configs/floatos_x86_64_defconfig
```kconfig
BR2_x86_64=y
BR2_TOOLCHAIN_BUILDROOT=y
BR2_TOOLCHAIN_BUILDROOT_VENDOR="floatos"
BR2_TOOLCHAIN_BUILDROOT_GLIBC=y
BR2_TOOLCHAIN_BUILDROOT_CXX=y
BR2_KERNEL_HEADERS_6_18=y
BR2_ENABLE_LOCALE=y

BR2_TARGET_GENERIC_HOSTNAME="floatos"
BR2_TARGET_GENERIC_ISSUE="FloatOS 0.1"
BR2_TARGET_TZ_INFO=y
BR2_TARGET_TZ_ZONELIST="Asia/Kolkata"
BR2_INIT_BUSYBOX=y
BR2_SYSTEM_BIN_SH_BUSYBOX=y
BR2_SYSTEM_DHCP="eth0"
BR2_ROOTFS_DEVICE_CREATION_DYNAMIC_EUDEV=y
BR2_PACKAGE_EUDEV=y
BR2_ROOTFS_USERS_TABLES="$(BR2_EXTERNAL_FLOATOS_PATH)/board/floatos/users.txt"
BR2_ROOTFS_POST_BUILD_SCRIPT="$(BR2_EXTERNAL_FLOATOS_PATH)/board/floatos/post-build.sh $(BR2_EXTERNAL_FLOATOS_PATH)/board/floatos/post-build-fixes.sh"

BR2_LINUX_KERNEL=y
BR2_LINUX_KERNEL_CUSTOM_VERSION=y
BR2_LINUX_KERNEL_CUSTOM_VERSION_VALUE="6.18.55"
BR2_LINUX_KERNEL_USE_DEFCONFIG=y
BR2_LINUX_KERNEL_DEFCONFIG="x86_64"
BR2_LINUX_KERNEL_CONFIG_FRAGMENT_FILES="$(BR2_EXTERNAL_FLOATOS_PATH)/board/floatos/linux.fragment"
BR2_LINUX_KERNEL_NEEDS_HOST_LIBELF=y

BR2_PACKAGE_LINUX_FIRMWARE=y
BR2_PACKAGE_LINUX_FIRMWARE_AMD_UCODE=y
BR2_PACKAGE_LINUX_FIRMWARE_AMDGPU=y
BR2_PACKAGE_LINUX_FIRMWARE_RADEON=y
BR2_PACKAGE_LINUX_FIRMWARE_RTL_RTW88=y

BR2_PACKAGE_DBUS=y
BR2_PACKAGE_XORG7=y
BR2_PACKAGE_MESA3D=y
BR2_PACKAGE_MESA3D_GALLIUM_DRIVER_RADEONSI=y
BR2_PACKAGE_MESA3D_GALLIUM_DRIVER_SOFTPIPE=y
BR2_PACKAGE_MESA3D_OPENGL_GLX=y
BR2_PACKAGE_MESA3D_OPENGL_EGL=y
BR2_PACKAGE_XSERVER_XORG_SERVER=y
BR2_PACKAGE_XSERVER_XORG_SERVER_MODULAR=y
BR2_PACKAGE_XDRIVER_XF86_INPUT_LIBINPUT=y
BR2_PACKAGE_XDRIVER_XF86_VIDEO_AMDGPU=y
BR2_PACKAGE_OPENBOX=y
BR2_PACKAGE_PCMANFM=y
BR2_PACKAGE_FEH=y
BR2_PACKAGE_XAPP_XSETROOT=y
BR2_PACKAGE_XAPP_XINIT=y
BR2_PACKAGE_XAPP_XCOMPMGR=y
BR2_PACKAGE_MATCHBOX=y
BR2_PACKAGE_MATCHBOX_PANEL=y
BR2_PACKAGE_XTERM=y
BR2_PACKAGE_ADWAITA_ICON_THEME=y
BR2_PACKAGE_LIBGTK3_X11=y
BR2_PACKAGE_IW=y
BR2_PACKAGE_WPA_SUPPLICANT=y
BR2_PACKAGE_WPA_SUPPLICANT_NL80211=y
BR2_PACKAGE_WPA_SUPPLICANT_CTRL_IFACE=y
BR2_PACKAGE_WPA_SUPPLICANT_DBUS=y
BR2_PACKAGE_CONNMAN=y
BR2_PACKAGE_CONNMAN_WIFI=y
BR2_PACKAGE_CONNMAN_CLIENT=y
BR2_PACKAGE_CONNMAN_LOOPBACK=y
BR2_PACKAGE_CONNMAN_ETHERNET=y
BR2_PACKAGE_ALSA_UTILS=y
BR2_PACKAGE_DILLO=y
BR2_PACKAGE_OPENSSL=y
BR2_PACKAGE_OPENSSL_FORCE_LIBOPENSSL=y
BR2_PACKAGE_CA_CERTIFICATES=y

BR2_TARGET_GRUB2=y
BR2_TARGET_GRUB2_I386_PC=y
BR2_TARGET_GRUB2_X86_64_EFI=y
BR2_TARGET_GRUB2_BOOT_PARTITION="cd"
BR2_TARGET_GRUB2_BUILTIN_MODULES_PC="boot linux normal iso9660 biosdisk part_msdos part_gpt"
BR2_TARGET_GRUB2_BUILTIN_MODULES_EFI="boot linux normal iso9660 part_gpt part_msdos fat"
BR2_TARGET_GRUB2_BUILTIN_CONFIG_PC="$(BR2_EXTERNAL_FLOATOS_PATH)/board/floatos/grub-pc.cfg"
BR2_TARGET_GRUB2_BUILTIN_CONFIG_EFI="$(BR2_EXTERNAL_FLOATOS_PATH)/board/floatos/grub-efi.cfg"
BR2_TARGET_ROOTFS_ISO9660=y
BR2_TARGET_ROOTFS_ISO9660_GRUB2=y
BR2_TARGET_ROOTFS_ISO9660_INITRD=y
BR2_TARGET_ROOTFS_ISO9660_BOOT_MENU="$(BR2_EXTERNAL_FLOATOS_PATH)/board/floatos/grub.cfg"
```

## package/floatos-shell/Config.in
```kconfig
config BR2_PACKAGE_FLOATOS_SHELL
    bool "floatos-shell"
    depends on BR2_PACKAGE_LIBGTK3_X11
    help
      FloatOS's own GTK3 desktop shell with an animated app launcher,
      floating dock, status panel, quick settings and desktop settings.
```
